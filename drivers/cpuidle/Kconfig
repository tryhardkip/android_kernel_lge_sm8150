## drivers/cpuidle/Kconfig
```kconfig
menu "CPU Idle"

config CPU_IDLE
	bool "CPU idle PM support"
	default y if ACPI || PPC_PSERIES
	help
	  CPU idle is a generic framework for supporting software-controlled
	  idle processor power management.  It includes modular cross-platform
	  governors that can be swapped during runtime.

	  If you're using an ACPI-enabled platform, you should say Y here.

if CPU_IDLE

config CPU_IDLE_MULTIPLE_DRIVERS
        bool

config CPU_IDLE_GOV_LADDER
	bool "Ladder governor (for periodic timer tick)"

config CPU_IDLE_GOV_MENU
	bool "Menu governor (for tickless system)"

config CPU_IDLE_GOV_TEO
	bool "Timer events oriented (TEO) governor (for tickless systems)"
	help
	  This governor implements a simplified idle state selection method
	  focused on timer events and does not do any interactivity boosting.

	  Some workloads benefit from using it and it generally should be safe
	  to use.  Say Y here if you are not happy with the alternatives.

config CPU_IDLE_GOV_NAP
	bool "Neural Adaptive Predictor (NAP) governor"
	help
	  This governor predicts, for each idle state, the probability that
	  the upcoming idle will reach that state's target residency, using a
	  small neural network (8->8 MLP trunk with an ordinal survival head)
	  refined by online learning.  It then selects the deepest feasible
	  state whose predicted survival meets a confidence level tunable via
	  /sys/devices/system/cpu/nap/confidence.

	  All arithmetic is fixed point, so no kernel FPU/SIMD is used and
	  results are identical across CPUs.

	  It does not out-rank menu or teo: select it explicitly with
	  cpuidle.governor=nap on the kernel command line.

config CPU_IDLE_GOV_NAP_SELFTEST
	bool "Self-test the NAP governor's fixed-point math at boot"
	depends on CPU_IDLE_GOV_NAP
	help
	  Verify the fixed-point log2, sigmoid and saturating-multiply
	  kernels during boot and report to dmesg.  Useful when porting to a
	  new architecture or toolchain.  Say N for production builds.

config DT_IDLE_STATES
	bool

menu "ARM CPU Idle Drivers"
depends on ARM || ARM64
source "drivers/cpuidle/Kconfig.arm"
endmenu

menu "MIPS CPU Idle Drivers"
depends on MIPS
source "drivers/cpuidle/Kconfig.mips"
endmenu

menu "POWERPC CPU Idle Drivers"
depends on PPC
source "drivers/cpuidle/Kconfig.powerpc"
endmenu

endif

config ARCH_NEEDS_CPU_IDLE_COUPLED
	def_bool n
endmenu
```

## kernel/pgo/Kconfig
```kconfig
# SPDX-License-Identifier: GPL-2.0
menu "Profile Guided Optimization (PGO) (EXPERIMENTAL)"

config ARCH_SUPPORTS_PGO_CLANG
	bool

config PGO_CLANG
	bool "Enable clang's PGO-based kernel profiling"
	depends on DEBUG_FS
	depends on ARCH_SUPPORTS_PGO_CLANG
	help
	  This option enables clang's PGO (Profile Guided Optimization) based
	  code profiling to better optimize the kernel.

	  If unsure, say N.

	  Run a representative workload for your application on a kernel
	  compiled with this option and download the raw profile file from
	  /sys/kernel/debug/pgo/profraw. This file needs to be processed with
	  llvm-profdata. It may be merged with other collected raw profiles.

	  Copy the resulting profile file into the kernel source tree (or host
	  it) and rebuild the kernel with -fprofile-use to produce an optimized
	  binary.

	  This profiling capability comes with a significant runtime and memory
	  overhead. Only enable it for the collection stage. It is not intended
	  for production kernels.
endmenu
```
